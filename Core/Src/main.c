/* USER CODE BEGIN Header */
/**
  ******************************************************************************
  * @file           : main.c
  * @brief          : Main program body
  ******************************************************************************
  * @attention
  *
  * <h2><center>&copy; Copyright (c) 2020 STMicroelectronics.
  * All rights reserved.</center></h2>
  *
  * This software component is licensed by ST under BSD 3-Clause license,
  * the "License"; You may not use this file except in compliance with the
  * License. You may obtain a copy of the License at:
  *                        opensource.org/licenses/BSD-3-Clause
  *
  ******************************************************************************
  */
/* USER CODE END Header */
/* Includes ------------------------------------------------------------------*/
#include "main.h"
#include "dma.h"
#include "quadspi.h"
#include "spi.h"
#include "tim.h"
#include "usart.h"
#include "gpio.h"

/* Private includes ----------------------------------------------------------*/
/* USER CODE BEGIN Includes */
#include "w25qxx.h"
#include "w25qxxConf.h"
#include "stdio.h"

/* USER CODE END Includes */

/* Private typedef -----------------------------------------------------------*/
/* USER CODE BEGIN PTD */



/* USER CODE END PTD */

/* Private define ------------------------------------------------------------*/
/* USER CODE BEGIN PD */
#define serialPortDebug huart1
#define serialPortCAM huart1
#define shrdPortFM hspi1
#define localPortFM hspi4

/* USER CODE END PD */

/* Private macro -------------------------------------------------------------*/
/* USER CODE BEGIN PM */
#ifdef __GNUC__
  #define PUTCHAR_PROTOTYPE int __io_putchar(int ch)
#else
  #define PUTCHAR_PROTOTYPE int fputc(int ch, FILE *f)
#endif

PUTCHAR_PROTOTYPE
{
  HAL_UART_Transmit(&serialPortDebug,(uint8_t *)&ch,1,0xFFFF);//Blocking mode printing
  return ch;
}

void write_3ByteAdd_FM(SPI_HandleTypeDef spiPort, uint32_t Addr, uint8_t writeDataByte);
//void write_3ByteAdd_FM(SPI_HandleTypeDef spiPort, uint32_t Addr);
int read_3ByteAdd_FM(SPI_HandleTypeDef spiPort, uint32_t Addr);
/* USER CODE END PM */

/* Private variables ---------------------------------------------------------*/

/* USER CODE BEGIN PV */

#if 1 /* FOLDED ARRAY */
unsigned char IMG[7330] = {
	0xFF, 0xD8, 0xFF, 0xE0, 0x00, 0x10, 0x4A, 0x46, 0x49, 0x46, 0x00, 0x01,
	0x01, 0x01, 0x00, 0xF0, 0x00, 0xF0, 0x00, 0x00, 0xFF, 0xDB, 0x00, 0x43,
	0x00, 0x02, 0x01, 0x01, 0x02, 0x01, 0x01, 0x02, 0x02, 0x02, 0x02, 0x02,
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	0xDE, 0x97, 0xEF, 0x03, 0xF9, 0x50, 0x82, 0xE8, 0xFF, 0xD9
};
#endif
/* ^^^^^ FOLDED ARRAY */

uint8_t SR=0x77;
uint8_t start=0x11;

uint16_t i=0;
uint16_t iLoop=0;
uint16_t jLoop=0;
uint16_t loop=0;

uint32_t adrs=0;

uint8_t WREN  =0x06;
uint8_t WRDI  =0x04;
uint8_t RDSR  =0x05;
uint8_t WRSR  =0x01;
uint8_t READ_3ByteAdd  =0x03;
uint8_t READ_4ByteAdd  =0x13;
uint8_t WRITE_3ByteAdd =0x02;
uint8_t WRITE_4ByteAdd =0x12;

uint8_t ERASE =0x20;
uint8_t SECTORERASE_3ByteAdd =0xD8;
uint8_t SECTORERASE_4ByteAdd =0xDC;
uint8_t GETDATA =0x00;

int *pDataByte;
uint8_t StringLength=0;
char txString [50];
char Rx_indx, Rx_Buffer[100], Transfer_cplt;
char Rx_dataDBG[2]={0x11, 0x11};
char Rx_dataCAM[2]={0x33, 0x33};
uint8_t commandCAM=0x29;
uint8_t ACKtoCAM=0x04;

#define csDelay 10
#define tiniestDelay 10
#define tinyDelay    100
#define fareDelay    2000



/* USER CODE END PV */

/* Private function prototypes -----------------------------------------------*/
void SystemClock_Config(void);
/* USER CODE BEGIN PFP */

/* USER CODE END PFP */

/* Private user code ---------------------------------------------------------*/
/* USER CODE BEGIN 0 */

/* USER CODE END 0 */

/**
  * @brief  The application entry point.
  * @retval int
  */
int main(void)
{
  /* USER CODE BEGIN 1 */

  /* USER CODE END 1 */

  /* MCU Configuration--------------------------------------------------------*/

  /* Reset of all peripherals, Initializes the Flash interface and the Systick. */
  HAL_Init();

  /* USER CODE BEGIN Init */

  /* USER CODE END Init */

  /* Configure the system clock */
  SystemClock_Config();

  /* USER CODE BEGIN SysInit */

  //serialPortDebug huart1
  //serialPortCAM huart2
  //shrdPortFM hspi1
  //localPortFM hspi4

  /* USER CODE END SysInit */

  /* Initialize all configured peripherals */
  MX_GPIO_Init();
  MX_DMA_Init();
  MX_SPI4_Init();
  MX_USART1_UART_Init();
  MX_SPI1_Init();
  MX_SPI3_Init();
  MX_QUADSPI_Init();
  MX_USART2_UART_Init();
  MX_TIM14_Init();
  /* USER CODE BEGIN 2 */
  W25qxx_Init();



  //#define testPortFM shrdPortFM //shrdPortFM or localPortFM

  printf("GRSS Satellite .. ICU code \r\n--------------------------\r\n");
  HAL_GPIO_WritePin(GPIOB, GPIO_PIN_10, GPIO_PIN_RESET); // Control the sharedFM, SET=STM32 RESET=ATMEGA
  HAL_Delay(100);

  char readBytes[200]="ABC";
  int i;
//  eraseSector_3ByteAdd_FM(localPortFM,0);
//  eraseSector_3ByteAdd_FM(shrdPortFM ,0);

  W25qxx_EraseBlock(0);

  W25qxx_ReadBytes(readBytes, 0, 16*10);
//  for ( i=0; i<200; i++) {if(i%16==0) {printf("\r\n");} printf("%X ",readBytes[i]);}

  W25qxx_WriteBlock(IMG, 0, 0, sizeof(IMG));

  W25qxx_ReadBytes(readBytes, 0, 16*10);
//  for ( i=0; i<200; i++) {if(i%16==0) {printf("\r\n");} printf("%X ",readBytes[i]);}




  uint8_t emptyLoop=0;

  /* USER CODE END 2 */

  /* Infinite loop */
  /* USER CODE BEGIN WHILE */
  while (1)
  {
		HAL_Delay(fareDelay);

	  if (emptyLoop==1) {
		  HAL_GPIO_WritePin(GPIOA, GPIO_PIN_4, GPIO_PIN_SET);
		  HAL_GPIO_WritePin(GPIOA, GPIO_PIN_5, GPIO_PIN_SET);
		  HAL_GPIO_WritePin(GPIOA, GPIO_PIN_6, GPIO_PIN_SET);
		  HAL_GPIO_WritePin(GPIOA, GPIO_PIN_7, GPIO_PIN_SET);
		  HAL_Delay(5000);
		  HAL_GPIO_WritePin(GPIOA, GPIO_PIN_4, GPIO_PIN_RESET);
		  HAL_GPIO_WritePin(GPIOA, GPIO_PIN_5, GPIO_PIN_RESET);
		  HAL_GPIO_WritePin(GPIOA, GPIO_PIN_6, GPIO_PIN_RESET);
		  HAL_GPIO_WritePin(GPIOA, GPIO_PIN_7, GPIO_PIN_RESET);
		  HAL_Delay(5000);
	  }
	  else {


	  		loop++;
	  		loop=(loop)%0x100;
	  		printf("--------------------------\r\nNew Loop:%d \r\n",loop);
    /* USER CODE END WHILE */

    /* USER CODE BEGIN 3 */

  		writeSR(localPortFM,0x40);
	  	chipSelect(localPortFM);
		HAL_SPI_Transmit(&localPortFM, (uint8_t *) &RDSR, 1, 100);
		HAL_SPI_Receive(&localPortFM, (uint8_t *) &SR, 1, 100);
	  	chipDeSelect(localPortFM);
		printf("SR of LocalFM:0x%02X \r\n", SR);
		HAL_Delay(10);

		writeSR(shrdPortFM,0x40);
	  	chipSelect(shrdPortFM);
		HAL_SPI_Transmit(&shrdPortFM, (uint8_t *) &RDSR, 1, 100);
		HAL_SPI_Receive (&shrdPortFM, (uint8_t *) &SR,   1, 100);
	  	chipDeSelect(shrdPortFM);
		printf("SR of SharedFM:0x%02X \r\n", SR);
		HAL_Delay(10);

	printf("MemoryID:0x%lX \r\n", W25qxx_ReadID());

  	HAL_Delay(tinyDelay);

  	adrs=loop;

	printf("Local Memory: \r\n");
	write_3ByteAdd_FM(localPortFM,adrs,adrs);
	read_3ByteAdd_FM(localPortFM,adrs);
	printf("Shared Memory: \r\n");
	write_3ByteAdd_FM(shrdPortFM,adrs,adrs);
	read_3ByteAdd_FM(shrdPortFM,adrs);
	  }
//
  }
  /* USER CODE END 3 */
}

/**
  * @brief System Clock Configuration
  * @retval None
  */
void SystemClock_Config(void)
{
  RCC_OscInitTypeDef RCC_OscInitStruct = {0};
  RCC_ClkInitTypeDef RCC_ClkInitStruct = {0};

  /** Configure the main internal regulator output voltage
  */
  __HAL_RCC_PWR_CLK_ENABLE();
  __HAL_PWR_VOLTAGESCALING_CONFIG(PWR_REGULATOR_VOLTAGE_SCALE3);

  /** Initializes the RCC Oscillators according to the specified parameters
  * in the RCC_OscInitTypeDef structure.
  */
  RCC_OscInitStruct.OscillatorType = RCC_OSCILLATORTYPE_HSI;
  RCC_OscInitStruct.HSIState = RCC_HSI_ON;
  RCC_OscInitStruct.HSICalibrationValue = RCC_HSICALIBRATION_DEFAULT;
  RCC_OscInitStruct.PLL.PLLState = RCC_PLL_NONE;
  if (HAL_RCC_OscConfig(&RCC_OscInitStruct) != HAL_OK)
  {
    Error_Handler();
  }

  /** Initializes the CPU, AHB and APB buses clocks
  */
  RCC_ClkInitStruct.ClockType = RCC_CLOCKTYPE_HCLK|RCC_CLOCKTYPE_SYSCLK
                              |RCC_CLOCKTYPE_PCLK1|RCC_CLOCKTYPE_PCLK2;
  RCC_ClkInitStruct.SYSCLKSource = RCC_SYSCLKSOURCE_HSI;
  RCC_ClkInitStruct.AHBCLKDivider = RCC_SYSCLK_DIV1;
  RCC_ClkInitStruct.APB1CLKDivider = RCC_HCLK_DIV1;
  RCC_ClkInitStruct.APB2CLKDivider = RCC_HCLK_DIV1;

  if (HAL_RCC_ClockConfig(&RCC_ClkInitStruct, FLASH_LATENCY_0) != HAL_OK)
  {
    Error_Handler();
  }
}

/* USER CODE BEGIN 4 */
void blink(uint8_t time){
	uint8_t on_time=100;
	uint8_t off_time=on_time*2;
	  HAL_GPIO_WritePin(GPIOE, GPIO_PIN_11, GPIO_PIN_SET);
	  HAL_Delay(on_time);
	  HAL_GPIO_WritePin(GPIOE, GPIO_PIN_11, GPIO_PIN_RESET);
	  HAL_Delay(off_time);
	  HAL_GPIO_WritePin(GPIOE, GPIO_PIN_12, GPIO_PIN_SET);
 	  HAL_Delay(on_time);
  	  HAL_GPIO_WritePin(GPIOE, GPIO_PIN_12, GPIO_PIN_RESET);
  	  HAL_Delay(off_time);
  	  HAL_GPIO_WritePin(GPIOE, GPIO_PIN_13, GPIO_PIN_SET);
  	  HAL_Delay(on_time);
  	  HAL_GPIO_WritePin(GPIOE, GPIO_PIN_13, GPIO_PIN_RESET);
  	  HAL_Delay(off_time);
  	  HAL_GPIO_WritePin(GPIOE, GPIO_PIN_14, GPIO_PIN_SET);
  	  HAL_Delay(on_time);
  	  HAL_GPIO_WritePin(GPIOE, GPIO_PIN_14, GPIO_PIN_RESET);
  	  HAL_Delay(off_time);
}

void chipSelect(SPI_HandleTypeDef spiPort){
	HAL_Delay(csDelay);
	HAL_GPIO_WritePin(GPIOA, GPIO_PIN_4, GPIO_PIN_RESET); // Shared hspi1 PA4
	HAL_GPIO_WritePin(GPIOE, GPIO_PIN_4, GPIO_PIN_RESET); // Shared hspi4 PA1

	HAL_GPIO_WritePin(GPIOE, GPIO_PIN_11, GPIO_PIN_SET);
	HAL_Delay(csDelay);
}

void chipDeSelect(SPI_HandleTypeDef spiPort){
	HAL_Delay(csDelay);
	HAL_GPIO_WritePin(GPIOA, GPIO_PIN_4, GPIO_PIN_SET); // for sharedFM
	HAL_GPIO_WritePin(GPIOE, GPIO_PIN_4, GPIO_PIN_SET); // for localFM

	HAL_GPIO_WritePin(GPIOE, GPIO_PIN_11, GPIO_PIN_RESET);
	HAL_Delay(csDelay);
}

void WRENABLE_FM(SPI_HandleTypeDef spiPort)
{
	chipSelect(spiPort);
	  HAL_Delay(csDelay);
	  HAL_SPI_Transmit(&spiPort, (uint8_t *) &WREN, 1, 10);
	  HAL_Delay(csDelay);
	chipDeSelect(spiPort);
}

void WRDISABLE_FM(SPI_HandleTypeDef spiPort)
{
	chipSelect(spiPort);
	  HAL_Delay(csDelay);
	  HAL_SPI_Transmit(&spiPort, (uint8_t *) &WRDI, 1, 10);
	  HAL_Delay(csDelay);
	chipDeSelect(spiPort);
}

void writeSR(SPI_HandleTypeDef spiPort, uint8_t StatusR)
{
	WRENABLE_FM(spiPort);
	chipSelect(spiPort);
	HAL_Delay(csDelay);
	HAL_SPI_Transmit(&spiPort, (uint8_t *) &WRSR, 1, 10);
	HAL_SPI_Transmit(&spiPort, (uint8_t *) &StatusR, 1, 10);
	HAL_Delay(csDelay);
//	  printf("SR written:0x%02X SR read:0x%02X \r\n",StatusR, ReadSR(spiPort));
	chipDeSelect(spiPort);
}

int ReadSR(SPI_HandleTypeDef spiPort)
{
	chipSelect(spiPort);
	uint8_t SR=0x77;
	HAL_Delay(csDelay);
	HAL_SPI_Transmit(&spiPort, (uint8_t *) &RDSR, 1, 10);
	HAL_SPI_Receive(&spiPort, (uint8_t *) &SR, 1, 10);
	HAL_Delay(csDelay);
	chipDeSelect(spiPort);

	return SR;
}

void write_3ByteAdd_FM(SPI_HandleTypeDef spiPort, uint32_t Addr, uint8_t writeDataByte){
			uint8_t B1Add=Addr>> 16;
			uint8_t B2Add=Addr>> 8;
			uint8_t B3Add=Addr;

			WRENABLE_FM(spiPort);
			chipSelect(spiPort);
	  		HAL_Delay(20);

			  //Sending the write command
			  HAL_SPI_Transmit(&spiPort, (uint8_t *) &WRITE_3ByteAdd, 1, 100);
			  //Sending the address
			  HAL_SPI_Transmit(&spiPort, (uint8_t *) &B1Add, 1, 100);
			  HAL_SPI_Transmit(&spiPort, (uint8_t *) &B2Add, 1, 100);
			  HAL_SPI_Transmit(&spiPort, (uint8_t *) &B3Add, 1, 100);
			  //Sending the data byte
			  HAL_SPI_Transmit(&spiPort, (uint8_t *) &writeDataByte, 1, 100);

//			  while(ReadSR(spiPort) & 0x01==true)
//			  {
//				  printf("Waiting/r/n");
//			  } //wait

			  //printing into debug terminal
			  printf("Wrote 0x%02X in    FM address 0x%02X%02X%02X\r\n",writeDataByte,B1Add,B2Add,B3Add);
	  		HAL_Delay(20);
			chipDeSelect(spiPort);
			WRDISABLE_FM(spiPort);
	return;
}

int read_3ByteAdd_FM(SPI_HandleTypeDef spiPort, uint32_t Addr){

	uint8_t readDataByte=0x77;

	uint8_t B1Add=Addr>> 16;
	uint8_t B2Add=Addr>> 8;
	uint8_t B3Add=Addr;

	chipSelect(spiPort);

	  //Sending the write command
	  HAL_SPI_Transmit(&spiPort, (uint8_t *) &READ_3ByteAdd, 1, 100);
	  //Sending the address
	  HAL_SPI_Transmit(&spiPort, (uint8_t *) &B1Add, 1, 100);
	  HAL_SPI_Transmit(&spiPort, (uint8_t *) &B2Add, 1, 100);
	  HAL_SPI_Transmit(&spiPort, (uint8_t *) &B3Add, 1, 100);
	  //Receiving the data byte
	  HAL_SPI_Receive(&spiPort, (uint8_t *) &readDataByte, 1, 100);

	  //printing into debug terminal
	  printf("read  0x%02X from  FM address 0x%02X%02X%02X\r\n",readDataByte,B1Add,B2Add,B3Add);

		  HAL_Delay(10);
		   chipDeSelect(spiPort);
		  HAL_Delay(10);

		  return readDataByte;
}

void eraseSector_3ByteAdd_FM(SPI_HandleTypeDef spiPort, uint32_t StartingAddr)
{
	uint8_t B1Add=StartingAddr>> 16;
	uint8_t B2Add=StartingAddr>> 8;
	uint8_t B3Add=StartingAddr;

	WRENABLE_FM(spiPort);
	chipSelect(spiPort);

	  HAL_Delay(10);
	  //Sending the write command
	  HAL_SPI_Transmit(&spiPort, (uint8_t *) &SECTORERASE_3ByteAdd, 1, 10);
	  //Sending the address
	  HAL_SPI_Transmit(&spiPort, (uint8_t *) &B1Add, 1, 10);
	  HAL_SPI_Transmit(&spiPort, (uint8_t *) &B2Add, 1, 10);
	  HAL_SPI_Transmit(&spiPort, (uint8_t *) &B3Add, 1, 10);

	  chipDeSelect(spiPort);
	  HAL_Delay(2000);

	  StringLength=sprintf(txString,"Erasing sector %X in FM \r\n",StartingAddr);
	  HAL_UART_Transmit(&serialPortDebug, (uint8_t *) &txString, StringLength, 100);

}


void write_4ByteAdd_FM(SPI_HandleTypeDef spiPort, uint32_t Addr, uint8_t writeDataByte){
			uint8_t B0Add=Addr>> 24;
			uint8_t B1Add=Addr>> 16;
			uint8_t B2Add=Addr>> 8;
			uint8_t B3Add=Addr;

			WRENABLE_FM(spiPort);
			chipSelect(spiPort);

			  //Sending the write command
			  HAL_SPI_Transmit(&spiPort, (uint8_t *) &WRITE_4ByteAdd, 1, 100);
			  //Sending the address
			  HAL_SPI_Transmit(&spiPort, (uint8_t *) &B0Add, 1, 100);
			  HAL_SPI_Transmit(&spiPort, (uint8_t *) &B1Add, 1, 100);
			  HAL_SPI_Transmit(&spiPort, (uint8_t *) &B2Add, 1, 100);
			  HAL_SPI_Transmit(&spiPort, (uint8_t *) &B3Add, 1, 100);
			  //Sending the data byte
			  HAL_SPI_Transmit(&spiPort, (uint8_t *) &writeDataByte, 1, 100);
			  //printing into debug terminal
			  StringLength=sprintf(txString,"Wrote %X in    FM address %X%X%X%X\r\n",writeDataByte,B0Add,B1Add,B2Add,B3Add);
	  		  HAL_UART_Transmit(&serialPortDebug, (uint8_t *) &txString, StringLength, 100);

	  		  chipDeSelect(spiPort);
	  		HAL_Delay(20);
	return;
}

int read_4ByteAdd_FM(SPI_HandleTypeDef spiPort, uint32_t Addr){

	uint8_t readDataByte=0x00;
	uint8_t B0Add=Addr>> 24;
	uint8_t B1Add=Addr>> 16;
	uint8_t B2Add=Addr>> 8;
	uint8_t B3Add=Addr;

	WRENABLE_FM(spiPort);
	chipSelect(spiPort);

	  //Sending the write command
	  HAL_SPI_Transmit(&spiPort, (uint8_t *) &READ_4ByteAdd, 1, 100);
	  //Sending the address
	  HAL_SPI_Transmit(&spiPort, (uint8_t *) &B0Add, 1, 100);
	  HAL_SPI_Transmit(&spiPort, (uint8_t *) &B1Add, 1, 100);
	  HAL_SPI_Transmit(&spiPort, (uint8_t *) &B2Add, 1, 100);
	  HAL_SPI_Transmit(&spiPort, (uint8_t *) &B3Add, 1, 100);
	  //Receiving the data byte
	  HAL_SPI_Receive(&spiPort, (uint8_t *) &readDataByte, 1, 100);

	  //printing into debug terminal
	  StringLength=sprintf(txString,"read  %X from  LocalFM address %02X%02X%02X%02X\r\n",readDataByte,B0Add,B1Add,B2Add,B3Add);
	  HAL_UART_Transmit(&serialPortDebug, (uint8_t *) &txString, StringLength, 100);

		  HAL_Delay(10);
		   chipDeSelect(spiPort);
		  HAL_Delay(10);

		  return readDataByte;
}

void eraseSector_4ByteAdd_FM(SPI_HandleTypeDef spiPort, uint32_t StartingAddr)
{
	uint8_t B0Add=StartingAddr>> 24;
	uint8_t B1Add=StartingAddr>> 16;
	uint8_t B2Add=StartingAddr>> 8;
	uint8_t B3Add=StartingAddr;

	WRENABLE_FM(spiPort);
	chipSelect(spiPort);

	  HAL_Delay(10);
	  //Sending the write command
	  HAL_SPI_Transmit(&spiPort, (uint8_t *) &SECTORERASE_4ByteAdd, 1, 10);
	  //Sending the address
	  HAL_SPI_Transmit(&spiPort, (uint8_t *) &B0Add, 1, 10);
	  HAL_SPI_Transmit(&spiPort, (uint8_t *) &B1Add, 1, 10);
	  HAL_SPI_Transmit(&spiPort, (uint8_t *) &B2Add, 1, 10);
	  HAL_SPI_Transmit(&spiPort, (uint8_t *) &B3Add, 1, 10);

	  chipDeSelect(spiPort);
	  HAL_Delay(2000);

	  StringLength=sprintf(txString,"Erasing sector %X in LocalFM \r\n",StartingAddr);
	  HAL_UART_Transmit(&serialPortDebug, (uint8_t *) &txString, StringLength, 100);

}

int display_bulk_4ByteAdd_FM(SPI_HandleTypeDef spiPort, uint32_t Addr, int bulk_size){

	uint8_t readDataByte=0x00;
	uint8_t B0Add=Addr>> 24;
	uint8_t B1Add=Addr>> 16;
	uint8_t B2Add=Addr>> 8;
	uint8_t B3Add=Addr;

	WRENABLE_FM(spiPort);
	chipSelect(spiPort);

	  //Sending the write command
	  HAL_SPI_Transmit(&spiPort, (uint8_t *) &READ_4ByteAdd, 1, 100);
	  //Sending the address
	  HAL_SPI_Transmit(&spiPort, (uint8_t *) &B0Add, 1, 100);
	  HAL_SPI_Transmit(&spiPort, (uint8_t *) &B1Add, 1, 100);
	  HAL_SPI_Transmit(&spiPort, (uint8_t *) &B2Add, 1, 100);
	  HAL_SPI_Transmit(&spiPort, (uint8_t *) &B3Add, 1, 100);
	  //Receiving the data byte

	  for (i=0; i<bulk_size;++i)
	  {
	  HAL_SPI_Receive(&spiPort, (uint8_t *) &readDataByte, 1, 100);
	  //printing into debug terminal
	  if(i%16==0)
	  			StringLength=sprintf(txString,"\r\n%02X ",readDataByte);
	  		else
	  			StringLength=sprintf(txString,"%02X ",readDataByte);

	  		HAL_UART_Transmit(&serialPortDebug, (uint8_t *) &txString, StringLength, 100);
	  }
		  //HAL_Delay(100);
		    chipDeSelect(spiPort);
		  //HAL_Delay(20);

		  return readDataByte;
}

void read_bulk_4ByteAdd_FM(SPI_HandleTypeDef spiPort, uint32_t Addr, uint8_t* pointer, uint16_t bulk_size )
{
	uint8_t readDataByte=0x00;
	uint8_t B0Add=Addr>> 24;
	uint8_t B1Add=Addr>> 16;
	uint8_t B2Add=Addr>> 8;
	uint8_t B3Add=Addr;

	WRENABLE_FM(spiPort);
	chipSelect(spiPort);

	  //Sending the write command
	  HAL_SPI_Transmit(&spiPort, (uint8_t *) &READ_4ByteAdd, 1, 100);
	  //Sending the address
	  HAL_SPI_Transmit(&spiPort, (uint8_t *) &B0Add, 1, 100);
	  HAL_SPI_Transmit(&spiPort, (uint8_t *) &B1Add, 1, 100);
	  HAL_SPI_Transmit(&spiPort, (uint8_t *) &B2Add, 1, 100);
	  HAL_SPI_Transmit(&spiPort, (uint8_t *) &B3Add, 1, 100);
	  //Receiving the data byte


	  //    	for (i=0;i<nbyte;i++){
	  //    		//*(buff + i)=*(dev->fp + i);
	  //    		*(buff + i)=read_4ByteAdd_LocalFM(dev->fp +i);
	  //    	}



	  for (i=0; i<bulk_size;i++)
	  {
		  HAL_SPI_Receive(&spiPort, (uint8_t *) &readDataByte, 1, 100);
		  *(pointer+i)=readDataByte;
	  }
		  //HAL_Delay(100);
		    chipDeSelect(spiPort);
		  //HAL_Delay(20);

		  //return readDataByte;
}

void saveImage_FM(SPI_HandleTypeDef spiPort, uint32_t StartingAddr,uint8_t *imageHex)
{
	//for (i=0; i<10; ++i) {imageHex[i] = dummyImage01[i]; }

	uint8_t imageByte=0xF0;
	uint8_t B0Add;
	uint8_t B1Add;
	uint8_t B2Add;
	uint8_t B3Add;
	int counter=256*200000;
	int pagesNum=sizeof(IMG)/counter+1;


	WRENABLE_FM(spiPort);
	//ReadSR(spiPort);

	chipSelect(spiPort);

	  //HAL_Delay(10);

	  //Sending the write command
	  HAL_SPI_Transmit(&spiPort, (uint8_t *) &WRITE_4ByteAdd, 1, 100);
	  //Sending the address
	B0Add=StartingAddr>> 24;
	B1Add=StartingAddr>> 16;
	B2Add=StartingAddr>> 8;
	B3Add=StartingAddr;
  HAL_SPI_Transmit(&spiPort, (uint8_t *) &B0Add, 1, 100);
  HAL_SPI_Transmit(&spiPort, (uint8_t *) &B1Add, 1, 100);
  HAL_SPI_Transmit(&spiPort, (uint8_t *) &B2Add, 1, 100);
  HAL_SPI_Transmit(&spiPort, (uint8_t *) &B3Add, 1, 100);


	  //Sending the image bytes
	  i=0;
	  while (((imageHex[i] != 0xD9) || (imageHex[i-1] != 0xFF)) && (counter>0)) {

		  //Sending the data byte
		  HAL_SPI_Transmit(&spiPort, (uint8_t *) &imageHex[i], 1, 100);
		  //HAL_Delay(5);

	  	  //printing image byte in the serial terminal
	  	  //HAL_UART_Transmit(&huart1, (uint8_t *) &imageHex[i], 1, 100);

		if(i%16==0)
			StringLength=sprintf(txString,"\r\n%02X ",imageHex[i]);
		else
			StringLength=sprintf(txString,"%02X ",imageHex[i]);

		HAL_UART_Transmit(&serialPortDebug, (uint8_t *) &txString, StringLength, 100);

		i++;
	  	counter--;


		  if (i%256==0)
		  {

			 // HAL_Delay(100);
			  	chipDeSelect(spiPort);
			  //HAL_Delay(100);

			  StringLength=sprintf(txString,"\r\nNew page, i=%u \r\n",i);
			  HAL_UART_Transmit(&serialPortDebug, (uint8_t *) &txString, StringLength, 100);


				WRENABLE_FM(spiPort);
				chipSelect(spiPort);
			  //Sending the write command
			  HAL_SPI_Transmit(&spiPort, (uint8_t *) &WRITE_4ByteAdd, 1, 100);
			  //Sending the address
			StartingAddr=StartingAddr+256;
			B0Add=StartingAddr>> 24;
			B1Add=StartingAddr>> 16;
			B2Add=StartingAddr>> 8;
			B3Add=StartingAddr;
		  HAL_SPI_Transmit(&spiPort, (uint8_t *) &B0Add, 1, 100);
		  HAL_SPI_Transmit(&spiPort, (uint8_t *) &B1Add, 1, 100);
		  HAL_SPI_Transmit(&spiPort, (uint8_t *) &B2Add, 1, 100);
		  HAL_SPI_Transmit(&spiPort, (uint8_t *) &B3Add, 1, 100);
		  }

	  }


	  //Write the last byte 0xD9
	  HAL_SPI_Transmit(&spiPort, (uint8_t *) &imageHex[i], 1, 100);
	  if(i%25==0)
	  	StringLength=sprintf(txString,"\r\n%02X ",imageHex[i]);
	  else
	  	StringLength=sprintf(txString,"%02X ",imageHex[i]);
	  HAL_UART_Transmit(&serialPortDebug, (uint8_t *) &txString, StringLength, 100);

	  //HAL_Delay(100);
	  	chipDeSelect(spiPort);
	  //HAL_Delay(100);

	  StringLength=sprintf(txString,"\r\n\r\nImageSize:%u, saved size:%u\r\n",sizeof(IMG),i+1);
	  HAL_UART_Transmit(&serialPortDebug, (uint8_t *) &txString, StringLength, 100);

		StringLength=sprintf(txString,"Image has been saved in FM \r\n\r\n");
		HAL_UART_Transmit(&serialPortDebug, (uint8_t *) &txString, StringLength, 100);

}

void readImage_FM(SPI_HandleTypeDef spiPort, uint32_t StartingAddr)
{

	uint8_t imageByte=0x00;
	uint8_t B0Add=StartingAddr>> 24;
	uint8_t B1Add=StartingAddr>> 16;
	uint8_t B2Add=StartingAddr>> 8;
	uint8_t B3Add=StartingAddr;

	B1Add=0;
	B2Add=0;
	B3Add=0;

	int counter=15;

	  HAL_Delay(1000);
	  //Sending the read command
	  HAL_SPI_Transmit(&spiPort, (uint8_t *) &READ_4ByteAdd, 1, 10);

	  //Sending the address
	  HAL_SPI_Transmit(&spiPort, (uint8_t *) &B0Add, 1, 10);
	  HAL_SPI_Transmit(&spiPort, (uint8_t *) &B1Add, 1, 10);
	  HAL_SPI_Transmit(&spiPort, (uint8_t *) &B2Add, 1, 10);
	  HAL_SPI_Transmit(&spiPort, (uint8_t *) &B3Add, 1, 10);


  	  //HAL_UART_Transmit(&huart2, (uint8_t *) &imageByte, 1, 10);

	  while (imageByte != 0xD9 && counter>0){
		  	  //Receiving image bytes
		  	  HAL_SPI_Receive(&spiPort, (uint8_t *) &imageByte, 1, 10);
		  	//HAL_SPI_TransmitReceive(&hspi1, (uint8_t *) &imageByte, (uint8_t *) &imageByte, 1,10);


		  	  //printing image byte in the serial terminal
		  	  HAL_UART_Transmit(&serialPortDebug, (uint8_t *) &imageByte, 1, 10);
		  	  counter--;
	  }

	  HAL_UART_Transmit(&serialPortDebug, "b", 1, 10);
	  HAL_UART_Transmit(&serialPortDebug, "b", 1, 10);
	  HAL_UART_Transmit(&serialPortDebug, "b", 1, 10);
	  HAL_UART_Transmit(&serialPortDebug, "\n", 1, 10);

	  HAL_Delay(10);



//7FFFD9

}

void getImage(SPI_HandleTypeDef spiPort, uint32_t StartingAddr, uint8_t imageSize){
	for (i=0; i<imageSize; ++i){
		//currentImage[i]=readImage(StartingAddr+i);
	}
}

void sendACKtoCAM(void){
	HAL_UART_Transmit(&serialPortCAM, (uint8_t *) &ACKtoCAM, 1, 100);
}
//Interrupt callback routine
void HAL_UART_RxCpltCallback(UART_HandleTypeDef *huart)
{
	uint8_t i;
	uint8_t receivedByte=0;

	StringLength=sprintf(txString,"%X is dataDBG\r\n",Rx_dataDBG[0]);
	HAL_UART_Transmit(&serialPortDebug, (uint8_t *) &txString, StringLength, 100);

	StringLength=sprintf(txString,"%X is dataCAM\r\n",Rx_dataCAM[0]);
	HAL_UART_Transmit(&serialPortDebug, (uint8_t *) &txString, StringLength, 100);

    if (huart->Instance == USART1)  //debug UART
        {
    	receivedByte=Rx_dataDBG[0];

    	StringLength=sprintf(txString,"\r\nThis Byte (%X) is received from this PORT:%u\r\n",receivedByte,huart->Instance);
    	HAL_UART_Transmit(&serialPortDebug, (uint8_t *) &txString, StringLength, 100);

       	if (receivedByte==commandCAM)
       	{
       		StringLength=sprintf(txString,"\r\nThis Command (%X)  is received from CAM\r\n",receivedByte);
    		HAL_UART_Transmit(&serialPortDebug, (uint8_t *) &txString, StringLength, 100);
    		sendACKtoCAM();
    		StringLength=sprintf(txString,"\r\n This ACK (%X)  is sent to CAM\r\n",ACKtoCAM);
    		HAL_UART_Transmit(&serialPortDebug, (uint8_t *) &txString, StringLength, 100);
       	}

  	  HAL_UART_Receive_DMA(&serialPortDebug, Rx_dataDBG, 1);
  	  HAL_UART_Receive_DMA(&serialPortCAM, Rx_dataCAM, 1);

        }
    else
    {
    	StringLength=sprintf(txString,"UART3 is receiving now\r\n");
    	HAL_UART_Transmit(&serialPortDebug, (uint8_t *) &txString, StringLength, 100);

  	  HAL_UART_Receive_DMA(&serialPortDebug, Rx_dataDBG, 1);
  	  HAL_UART_Receive_DMA(&serialPortCAM, Rx_dataCAM, 1);

    }

}
/* USER CODE END 4 */

/**
  * @brief  This function is executed in case of error occurrence.
  * @retval None
  */
void Error_Handler(void)
{
  /* USER CODE BEGIN Error_Handler_Debug */
  /* User can add his own implementation to report the HAL error return state */

  /* USER CODE END Error_Handler_Debug */
}

#ifdef  USE_FULL_ASSERT
/**
  * @brief  Reports the name of the source file and the source line number
  *         where the assert_param error has occurred.
  * @param  file: pointer to the source file name
  * @param  line: assert_param error line source number
  * @retval None
  */
void assert_failed(uint8_t *file, uint32_t line)
{
  /* USER CODE BEGIN 6 */
  /* User can add his own implementation to report the file name and line number,
     tex: printf("Wrong parameters value: file %s on line %d\r\n", file, line) */
  /* USER CODE END 6 */
}
#endif /* USE_FULL_ASSERT */
